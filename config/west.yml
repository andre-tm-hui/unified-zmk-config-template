## config/west.yml
```yaml
manifest:
  remotes:
    - name: zmkfirmware
      url-base: https://github.com/zmkfirmware
    - name: bullwinkle3000
      url-base: https://github.com/bullwinkle3000
    - name: badjeff
      url-base: https://github.com/badjeff
    - name: andre-tm-hui
      url-base: https://github.com/andre-tm-hui
    # Additional modules containing boards/shields/custom code can be listed here as well
    # See https://docs.zephyrproject.org/3.2.0/develop/west/manifest.html#projects
  projects:
    - name: zmk
      remote: zmkfirmware
      revision: main
      import: app/west.yml
    - name: zmk-input-processor-xyz
      remote: badjeff
      revision: main
    - name: zmk-pmw3610-driver
      remote: badjeff
      revision: main
  self:
    path: config
```
